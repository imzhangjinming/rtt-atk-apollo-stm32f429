## Kconfig
```kconfig
mainmenu "RT-Thread Configuration"

config BSP_DIR
    string
    option env="BSP_ROOT"
    default "."

config RTT_DIR
    string
    option env="RTT_ROOT"
    default "rt-thread"

config PKGS_DIR
    string
    option env="PKGS_ROOT"
    default "packages"

config APP_DIR
    string
    default "applications"

source "$RTT_DIR/Kconfig"
source "$PKGS_DIR/Kconfig"
source "libraries/Kconfig"
source "board/Kconfig"
    
```

## applications/hello/Kconfig
```kconfig
menu "hello module"

    config RT_USING_HELLO
        bool "Enable hello module"
        default y
        help
            Enable hello module

    config RT_HELLO_NAME
        string "Hello name"
        default "RT-Thread"
        help
            Set hello name

    config RT_HELLO_VALUE
        int "Hello value"
        default 666
endmenu
```
